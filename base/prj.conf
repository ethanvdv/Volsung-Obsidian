## CMakeLists.txt
```
# SPDX-License-Identifier: Apache-2.0
#Setting to exclusively build for the dongle

set(BOARD nrf52840dongle_nrf52840)
set(CONF_FILE prj.conf usb.conf shell.conf)
set(DTC_OVERLAY_FILE dtc_shell.overlay)

cmake_minimum_required(VERSION 3.13.1)
find_package(Zephyr REQUIRED HINTS $ENV{ZEPHYR_BASE})
project(base)
FILE(GLOB app_sources src/*.c)
include_directories(src/)

#Add include_directories for libraries, path starts from this files location.

target_sources(app PRIVATE ${app_sources}
                           )

zephyr_library_include_directories(${ZEPHYR_BASE}/samples/bluetooth)
```

## prj.conf
```kconfig
CONFIG_BT=y
CONFIG_BT_BROADCASTER=y
CONFIG_BT_OBSERVER=y
CONFIG_BT_DEBUG_LOG=y
CONFIG_CBPRINTF_FP_SUPPORT=y
CONFIG_BT_DEVICE_NAME="Thingy"

CONFIG_I2C_LOG_LEVEL_DBG=y
CONFIG_LOG=y
CONFIG_STDOUT_CONSOLE=y
CONFIG_I2C=y
CONFIG_SENSOR=y
CONFIG_SERIAL=y
CONFIG_GPIO=y
CONFIG_UART_INTERRUPT_DRIVEN=y
CONFIG_CBPRINTF_FP_SUPPORT=y
```

## shell.conf
```kconfig
# #-----------------------------SHELL_CONF--------------------------------------
CONFIG_SHELL_BACKEND_SERIAL_CHECK_DTR=y
CONFIG_UART_LINE_CTRL=y
CONFIG_SHELL_BACKEND_SERIAL_INIT_PRIORITY=51
CONFIG_SHELL=y
CONFIG_SHELL_BACKENDS=y
CONFIG_SHELL_BACKEND_SERIAL=y

CONFIG_SHELL_PROMPT_UART="CSSE4011:~$"

CONFIG_SHELL_CMDS=y
CONFIG_SHELL_TAB=y
CONFIG_SHELL_TAB_AUTOCOMPLETION=y
CONFIG_SHELL_VT100_COLORS=y
CONFIG_KERNEL_SHELL=y
#-----------------------------------------------------------------------------

#-----------------------------SHELL_LOGGING-----------------------------------
CONFIG_LOG=y
CONFIG_LOG_PRINTK=y
#-----------------------------------------------------------------------------
```

## usb.conf
```kconfig
#----------------------------------USB SETUP----------------------------------
CONFIG_USB_DEVICE_STACK=y
#-----------------------------------------------------------------------------

#--------------------------------USB_OPTIONS----------------------------------
CONFIG_USB_DEVICE_PRODUCT="Base - Group 7"
CONFIG_USB_DEVICE_MANUFACTURER="Wilfred MK"
CONFIG_USB_DEVICE_VID=0xC553
CONFIG_USB_DEVICE_PID=0x4011
#-----------------------------------------------------------------------------
```

## src/main.c
```c
/* main.c - Application main entry point */

/*
 * Copyright (c) 2015-2016 Intel Corporation
 *
 * SPDX-License-Identifier: Apache-2.0
 */

#include <zephyr/types.h>
#include <stddef.h>
#include <zephyr/sys/printk.h>
#include <zephyr/sys/util.h>

#include <zephyr/bluetooth/bluetooth.h>
#include <zephyr/bluetooth/hci.h>

/** Private Defines *******************************************/
#define PACKET_BUFFER_SIZE 15
#define DEVICE_NAME        CONFIG_BT_DEVICE_NAME
#define DEVICE_NAME_LEN    (sizeof(DEVICE_NAME) - 1)

/** Private Variables *****************************************/

uint8_t packetBuffer[PACKET_BUFFER_SIZE];

const struct bt_data ad[] = {
	BT_DATA(BT_DATA_MANUFACTURER_DATA, packetBuffer, PACKET_BUFFER_SIZE),
};

/** Scan Struct Information **/
static const struct bt_data sd[] = {
    BT_DATA(BT_DATA_NAME_COMPLETE, DEVICE_NAME, DEVICE_NAME_LEN),
};

// static void scan_cb(const bt_addr_le_t *addr, int8_t rssi, uint8_t adv_type,
// 		    struct net_buf_simple *buf)
// {
// 	// mfg_data[2]++;
	
// }


/** Bluetooth ready callback **/
static void bt_ready(int err) {
    char addr_s[BT_ADDR_LE_STR_LEN];
    bt_addr_le_t addr = {0};
    size_t count = 1;

    if (err) {
        printk("Bluetooth init failed (err %d)\n", err);
        return;
    }

    printk("Bluetooth initialized\n");

    /* Start advertising */
    err = bt_le_adv_start(
        BT_LE_ADV_NCONN, ad, ARRAY_SIZE(ad), sd, ARRAY_SIZE(sd));
    if (err) {
        printk("Advertising failed to start (err %d)\n", err);
        return;
    }

    /* For connectable advertising you would use
     * bt_le_oob_get_local().  For non-connectable non-identity
     * advertising an non-resolvable private address is used;
     * there is no API to retrieve that.
     */

    bt_id_get(&addr, &count);
    bt_addr_le_to_str(&addr, addr_s, sizeof(addr_s));

    printk("Beacon started, advertising as %s\n", addr_s);
}

void main(void)
{
	const struct device *const sensor = DEVICE_DT_GET_ONE(st_lis2dh);

	// Set sensor values
	struct sensor_value odr_attr;
	odr_attr.val1 = 1;
	odr_attr.val2 = 0;
	if (!device_is_ready(sensor)) {
		printk("sensor: device not ready.\n");
		return;
	}

	if (sensor_attr_set(sensor, SENSOR_CHAN_ACCEL_XYZ,
			SENSOR_ATTR_SAMPLING_FREQUENCY, &odr_attr) < 0) 
	{
		printk("Cannot set sampling frequency for accelerometer.\n");
		return;
	}

	int err;

	err = bt_enable(bt_ready);
    if (err) {
        printk("Bluetooth init failed (err %d)\n", err);
        return;
    }

	for (int i = 0; i < PACKET_BUFFER_SIZE; i++) {
		packetBuffer[i] = 0x00;
	}
	

	printk("Bluetooth initialized\n");

	/* Start advertising */
	err = bt_le_adv_start(BT_LE_ADV_NCONN, ad, ARRAY_SIZE(ad),
					NULL, 0);
	if (err) {
		printk("Advertising failed to start (err %d)\n", err);
		return;
	}
	struct sensor_value accel[3];
	int rc;
	
	do {

		rc = sensor_sample_fetch(sensor);
		if (rc == 0) {
        	rc = sensor_channel_get(sensor, SENSOR_CHAN_ACCEL_XYZ, accel);
			float x_accel = (float)(sensor_value_to_double(&accel[0]));
			float y_accel = (float)(sensor_value_to_double(&accel[1]));
			float z_accel = (float)(sensor_value_to_double(&accel[2]));
			uint8_t x_buff[4], y_buff[4], z_buff[4];
			memcpy(x_buff, &x_accel, sizeof(float));
			memcpy(y_buff, &y_accel, sizeof(float));
			memcpy(z_buff, &z_accel, sizeof(float));
			for (int i = 0; i < 4; i++) {
				packetBuffer[i + 2] = x_buff[i];
			}
			for (int i = 0; i < 4; i++) {
				packetBuffer[i + 6] = y_buff[i];
			}
			for (int i = 0; i < 4; i++) {
				packetBuffer[i + 10] = z_buff[i];
			}
			printf("X Buffer\n");
			for (int i = 0; i < 4; i++) {
				printf("%X:", x_buff[i]);
			}
			printf("\n");
			printf("Y Buffer\n");
			for (int i = 0; i < 4; i++) {
				printf("%X:", y_buff[i]);
			}
			printf("\n");
			printf("Z Buffer\n");
			for (int i = 0; i < 4; i++) {
				printf("%X:", z_buff[i]);
			}
			printf("\n");
			for (int i = 0; i < PACKET_BUFFER_SIZE; i++) {
				printf("%X:", packetBuffer[i]);
			}
			printf("\n");

		k_sleep(K_MSEC(50));

		const struct bt_data adNew[] = {
			BT_DATA(BT_DATA_MANUFACTURER_DATA, packetBuffer, PACKET_BUFFER_SIZE),
		};

		k_sleep(K_MSEC(50));


		err = bt_le_adv_update_data(adNew, ARRAY_SIZE(adNew), sd, ARRAY_SIZE(sd));
		if (err) {
			printk("We have encountered the error %d while trying to update "
				"the ble data\r\n",
				err);
		}

		


		// err = bt_le_adv_stop();
		// if (err) {
		// 	printk("Advertising failed to stop (err %d)\n", err);
		// 	return;
		// }

	} while (1);
}
```

## src/base.c
```c
#include <zephyr/types.h>
#include <stddef.h>
#include <errno.h>
#include <zephyr.h>
#include <sys/printk.h>
#include <drivers/gpio.h>
#include <drivers/uart.h>
#include <usb/usb_device.h>

#include <bluetooth/bluetooth.h>
#include <bluetooth/hci.h>
#include <bluetooth/conn.h>
#include <bluetooth/uuid.h>
#include <bluetooth/gatt.h>
#include <sys/byteorder.h>
#include <stdio.h>
#include "nodes.h"

#include "base.h"

char* target_device_names[] = {
    "62:8A:FA:08:AC:F3 (random)",
    "79:D3:8C:F0:D2:29 (random)",
};

/* Bluetooth connection default */
static struct bt_conn *default_conn;


/* Bluetooth connection default */
static struct bt_conn *default_conn2;

/* Bluetooth connected flag */
bool ble_connected;

/* Bluetooth connected flag */
bool ble_connected2;


/* Buffer size of UUID array */
#define UUID_BUFFER_SIZE 16

/* The devicetree node identifier for the "led0" alias. */
#define LED0_NODE DT_ALIAS(led1)
#define LED0 DT_GPIO_LABEL(LED0_NODE, gpios)
#define PIN DT_GPIO_PIN(LED0_NODE, gpios)
#define FLAGS DT_GPIO_FLAGS(LED0_NODE, gpios)

/* Mobile device's uuid */
uint16_t mobile_uuid[] = {0xd0, 0x92, 0x67, 0x35, 0x78, 0x16, 0x21, 0x91,
                          0x26, 0x49, 0x60, 0xeb, 0x06, 0xa7, 0xca, 0xcd};

// /* Mobile device's node rssi characteristic uuid */
// static struct bt_uuid_128 node_rssi_uuid = BT_UUID_INIT_128(
//     0xd2, 0x92, 0x67, 0x35, 0x78, 0x16, 0x21, 0x91,
//     0x26, 0x49, 0x60, 0xeb, 0x06, 0xa7, 0xca, 0xcd);

// /* Mobile device's node rssi characteristic uuid */
// static struct bt_uuid_128 node_rssi_uuid = BT_UUID_INIT_128(
//     0xd2, 0x92, 0x67, 0x35, 0x78, 0x16, 0x21, 0x91,
//     0x26, 0x49, 0x60, 0xeb, 0x06, 0xa7, 0xca, 0xcd);


static struct bt_uuid_128 imu_accel_uuid = BT_UUID_INIT_128(
    0xd1, 0x92, 0x67, 0x35, 0x78, 0x16, 0x21, 0x91,
    0x26, 0x49, 0x60, 0xeb, 0x06, 0xa7, 0xca, 0xcd);

static struct bt_uuid_128 imu_gyro_uuid = BT_UUID_INIT_128(
    0xd2, 0x92, 0x67, 0x35, 0x78, 0x16, 0x21, 0x91,
    0x26, 0x49, 0x60, 0xeb, 0x06, 0xa7, 0xca, 0xcd);


/* Parse device's bluetooth data and user data and attempt to connect to device */
static bool parse_device(struct bt_data *data, void *user_data);

/* Handle bluetooth scan proceedure */
static void start_scan(void);

/* RSSI RX BUFFER */
int16_t rx_rssi[] = {0x00, 0x00, 0x00, 0x00, 0x00, 0x00, 0x00, 0x00, 0x00, 0x00, 0x00, 0x00};

int16_t rx_accel[] = {0x00, 0x00, 0x00};

int16_t rx_gyro[] = {0x00, 0x00, 0x00};

int16_t rx_accel2[] = {0x00, 0x00, 0x00};

int16_t rx_gyro2[] = {0x00, 0x00, 0x00};



/**
 * @brief Scans for connectable events
 * 
 * @param addr : connection's address
 * @param rssi : connection's rssi
 * @param adv_type : the advertising type of the connection
 * @param buf : the connection buffer
 */
static void scan_cb(const bt_addr_le_t *addr, int8_t rssi, uint8_t adv_type,
		    struct net_buf_simple *buf) {
	// if (default_conn) {
    //     return;
    // }

    if (adv_type == BT_GAP_ADV_TYPE_ADV_IND ||
        adv_type == BT_GAP_ADV_TYPE_ADV_DIRECT_IND) {
        bt_data_parse(buf, parse_device, (void *)addr);
    }
}

/**
 * @brief handles connection of target device
 * 
 * @param data : bluetooth data
 * @param user_data : data from the user
 * 
 * @returns : true on success, false otherwise
 */
static bool parse_device(struct bt_data *data, void *user_data) {

    char addr_str[BT_ADDR_LE_STR_LEN];
    bt_addr_le_t *addr = user_data;
	int err;

	// if (default_conn) {
	// 	return;
	// }

	bt_addr_le_to_str(addr, addr_str, sizeof(addr_str));
    printk("Device found: %s \n", addr_str);
    // char* reduced_address = strtok(addr_str, " ");
    if (strcmp(addr_str, target_device_names[0]) == 0) {
        int err = bt_le_scan_stop();
        if (err) {
            printk("scan stop failed (err %d)\n", err);
            start_scan();
            return true;
        }
        k_msleep(10);

        printk("here3");
        struct bt_le_conn_param *param = BT_LE_CONN_PARAM_DEFAULT;
        err = bt_conn_le_create(addr, BT_CONN_LE_CREATE_CONN,
                                            param, &default_conn);
        if (err) {
            printk("Create conn failed (err %d)\n", err);
            start_scan();
        }
        if (!ble_connected2){
            start_scan();
        }
        return false;

    }
    if (strcmp(addr_str, target_device_names[1]) == 0) {
        printk("here4");
        int err = bt_le_scan_stop();
        if (err) {
            printk("scan stop failed (err %d)\n", err);
            start_scan();
            return true;
        }
        k_msleep(10);
        struct bt_le_conn_param *param = BT_LE_CONN_PARAM_DEFAULT;
        err = bt_conn_le_create(addr, BT_CONN_LE_CREATE_CONN,
                                            param, &default_conn2);
        if (err) {
            printk("Create conn failed (err %d)\n", err);
            start_scan();
        }
        if (!ble_connected){
            start_scan();
        }
        return false;

    }
    return true;
}




    // bt_addr_le_t *addr = user_data;
    // int i;
    // int matchedCount = 0;

    // if (data->type == BT_DATA_UUID128_ALL) {
    //     uint16_t temp = 0;
    //     for (i = 0; i < data->data_len; i++) {
    //         temp = data->data[i];
    //         if (temp == mobile_uuid[i]) {
    //             matchedCount++;
    //         }
    //     }
    //     if (matchedCount == UUID_BUFFER_SIZE) {
    //         if (!ble_connected){
    //             printk("Mobile UUID Found, attempting to connect\n");
    //             // int err = bt_le_scan_stop();
    //             // k_msleep(10);
    //             // if (err) {
    //             //     printk("Stop LE scan failed (err %d)\n", err);
    //             //     return true;
    //             // }
    //             struct bt_le_conn_param *param = BT_LE_CONN_PARAM_DEFAULT;
    //             err = bt_conn_le_create(addr, BT_CONN_LE_CREATE_CONN,
    //                                     param, &default_conn);
    //             if (err) {
    //                 printk("Create conn failed (err %d)\n", err);
    //                 start_scan();
    //             }
    //             return false;

            
    //         }
            
    //     }
    // }
//     return true;
// }



/**
 * @brief Starts passive BLE scanning for nearby
 *          devices.
 */
static void start_scan(void) {
    int err;
    err = bt_le_scan_start(BT_LE_SCAN_PASSIVE, scan_cb);
    if (err) {
        printk("Scanning failed to start (err %d)\n", err);
        return;
    }
    printk("Scanning successfully started\n");
}

/**
 * @brief read rssi values and copy them to rx_rssi buffer
 * 
 * @param conn : the bluetooth connection
 * @param err : connection err value
 * @param params : gatt read parameters
 * @param data : the connection data
 * @param length : length of connection data
 * 
 * @returns : 0 on success
 */
uint8_t read_accel(struct bt_conn *conn, uint8_t err,
                              struct bt_gatt_read_params *params,
                              const void *data, uint16_t length) {
    memcpy(&rx_accel, data, sizeof(rx_accel));
    return 0;
}


/**
 * @brief read rssi values and copy them to rx_rssi buffer
 * 
 * @param conn : the bluetooth connection
 * @param err : connection err value
 * @param params : gatt read parameters
 * @param data : the connection data
 * @param length : length of connection data
 * 
 * @returns : 0 on success
 */
uint8_t read_gyro(struct bt_conn *conn, uint8_t err,
                              struct bt_gatt_read_params *params,
                              const void *data, uint16_t length) {
    memcpy(&rx_gyro, data, sizeof(rx_gyro));
    return 0;
}

/**
 * @brief read rssi values and copy them to rx_rssi buffer
 * 
 * @param conn : the bluetooth connection
 * @param err : connection err value
 * @param params : gatt read parameters
 * @param data : the connection data
 * @param length : length of connection data
 * 
 * @returns : 0 on success
 */
uint8_t read_accel2(struct bt_conn *conn, uint8_t err,
                              struct bt_gatt_read_params *params,
                              const void *data, uint16_t length) {
    memcpy(&rx_accel2, data, sizeof(rx_accel2));
    return 0;
}


/**
 * @brief read rssi values and copy them to rx_rssi buffer
 * 
 * @param conn : the bluetooth connection
 * @param err : connection err value
 * @param params : gatt read parameters
 * @param data : the connection data
 * @param length : length of connection data
 * 
 * @returns : 0 on success
 */
uint8_t read_gyro2(struct bt_conn *conn, uint8_t err,
                              struct bt_gatt_read_params *params,
                              const void *data, uint16_t length) {
    memcpy(&rx_gyro2, data, sizeof(rx_gyro2));
    return 0;
}

/**
 * @brief handler operation after connecting to the mobile device
 * 
 * @param conn : the bluetooth connection
 * @param err : connection error
 */
static void connected(struct bt_conn *conn, uint8_t err) {
    if (conn == default_conn){
        printk("here1\n");
        char addr[BT_ADDR_LE_STR_LEN];
        bt_addr_le_to_str(bt_conn_get_dst(conn), addr, sizeof(addr));
        if (err) {
            printk("Failed to connect to %s (%u)\n", addr, err);
            bt_conn_unref(default_conn);
            default_conn = NULL;
            start_scan();
            return;
        }
        printk("Connected device 1: %s\n", addr);
        ble_connected = true;
    }
	 if (conn == default_conn2){
        printk("here2");
        char addr[BT_ADDR_LE_STR_LEN];
        bt_addr_le_to_str(bt_conn_get_dst(conn), addr, sizeof(addr));
        if (err) {
            printk("Failed to connect to %s (%u)\n", addr, err);
            bt_conn_unref(default_conn);
            default_conn = NULL;
            start_scan();
            return;
        }
        printk("Connected device 2: %s\n", addr);
        ble_connected2 = true;
    }
    printk("here1");
    // if (ble_connected == false){
    if ((conn != default_conn) && (conn != default_conn2)) {
        return;
    }
    // printk("Connected: %s\n", addr);
    // ble_connected = true;
    // // }
	
}

/**
 * @brief handler for disconnection proceedures
 * 
 * @param conn : the bluetooth connection
 * @param reason : err for disconnection
 */
static void disconnected(struct bt_conn *conn, uint8_t reason) {
	char addr[BT_ADDR_LE_STR_LEN];
	if (conn != default_conn) {
		return;
	}
    if (conn == default_conn) {
		bt_addr_le_to_str(bt_conn_get_dst(conn), addr, sizeof(addr));
        printk("Disconnected device 1: %s (reason 0x%02x)\n", addr, reason);
        bt_conn_unref(default_conn);
        default_conn = NULL;
        ble_connected = false;
        start_scan();
	}
    if (conn == default_conn2) {
		bt_addr_le_to_str(bt_conn_get_dst(conn), addr, sizeof(addr));
        printk("Disconnected device 2: %s (reason 0x%02x)\n", addr, reason);
        bt_conn_unref(default_conn2);
        default_conn2 = NULL;
        ble_connected = false;
        start_scan();
	}
	
}

/**
 * @brief Connection callback struct, required to set conn/disconn
 *          function pointers.
 */
static struct bt_conn_cb conn_callbacks = {
    .connected = connected,
    .disconnected = disconnected,
};

/**
 * @brief Thread for reading rssi values from mobile device
 */
void thread_ble_read_out(void) {
    static struct bt_gatt_read_params read_params_accel = {
        .func = read_accel,
        .handle_count = 0,
        .by_uuid.uuid = &imu_accel_uuid.uuid,
        .by_uuid.start_handle = BT_ATT_FIRST_ATTRIBUTE_HANDLE,
        .by_uuid.end_handle = BT_ATT_LAST_ATTRIBUTE_HANDLE,
    };
    static struct bt_gatt_read_params read_params_gyro = {
        .func = read_gyro,
        .handle_count = 0,
        .by_uuid.uuid = &imu_gyro_uuid.uuid,
        .by_uuid.start_handle = BT_ATT_FIRST_ATTRIBUTE_HANDLE,
        .by_uuid.end_handle = BT_ATT_LAST_ATTRIBUTE_HANDLE,
    };
    static struct bt_gatt_read_params read_params_accel2 = {
        .func = read_accel2,
        .handle_count = 0,
        .by_uuid.uuid = &imu_accel_uuid.uuid,
        .by_uuid.start_handle = BT_ATT_FIRST_ATTRIBUTE_HANDLE,
        .by_uuid.end_handle = BT_ATT_LAST_ATTRIBUTE_HANDLE,
    };
    static struct bt_gatt_read_params read_params_gyro2 = {
        .func = read_gyro2,
        .handle_count = 0,
        .by_uuid.uuid = &imu_gyro_uuid.uuid,
        .by_uuid.start_handle = BT_ATT_FIRST_ATTRIBUTE_HANDLE,
        .by_uuid.end_handle = BT_ATT_LAST_ATTRIBUTE_HANDLE,
    };
    while (1) {
        if ((ble_connected) && (ble_connected2)){
            bt_gatt_read(default_conn, &read_params_accel);
            bt_gatt_read(default_conn, &read_params_gyro);

            bt_gatt_read(default_conn2, &read_params_accel2);
            bt_gatt_read(default_conn2, &read_params_gyro2);

            printk("^%d,%d,%d,%d,%d,%d?%d,%d,%d,%d,%d,%d~", rx_accel[0], rx_accel[1], rx_accel[2], rx_gyro[0], rx_gyro[1], rx_gyro[2],
            rx_accel2[0], rx_accel2[1], rx_accel2[2], rx_gyro2[0], rx_gyro2[1], rx_gyro2[2]);
            
            // print_activenodes(rx_rssi);  
        }
        k_msleep(100);
    }
}

/**
 * @brief BLE Base entry thread, starts initial ble scanning.
 *          When a valid mobile device is connected.
 */
void thread_ble_base(void) {
    int err;
    err = bt_enable(NULL);
    default_conn = NULL;
    default_conn2 = NULL;
    if (err) {
        printk("Bluetooth init failed (err %d)\n", err);
        return;
    }
    printk("Bluetooth initialized\n");
    bt_conn_cb_register(&conn_callbacks);
    start_scan();
    printk("Debug_1\n");
}


/**
 * @brief Super important thread that will ensure le
 * 			led is blinking. Like i said, this is super important.
 * 
 */
void thread_ble_led(void) {
    ble_connected = false;
    ble_connected2 = false;
    bool led_is_on = true;
    gpio_pin_configure(device_get_binding(LED0), PIN, GPIO_OUTPUT_ACTIVE | FLAGS);
    while (1) {
        led_is_on = !led_is_on;
        if (ble_connected) {
            gpio_pin_set(device_get_binding(LED0), PIN, (int)false);
            k_msleep(250);
        }
        else {
            gpio_pin_set(device_get_binding(LED0), PIN, (int)led_is_on);
            k_msleep(250);
        }
    }
}
```

## src/base.h
```c
#ifndef BLE_BASE_H
#define BLE_BASE_H

/* uuid buffer size */
#define UUID_BUFFER_SIZE 16
/* The devicetree node identifier for the "led0" alias. */
#define LED0_NODE DT_ALIAS(led1)
#define LED0 DT_GPIO_LABEL(LED0_NODE, gpios)
#define PIN DT_GPIO_PIN(LED0_NODE, gpios)
#define FLAGS DT_GPIO_FLAGS(LED0_NODE, gpios)

void thread_ble_read_out(void);

void thread_ble_base(void);

void thread_ble_led(void);

#endif
```

## src/mainc.c
```c
/* main.c - Application main entry point */

/*
 * Copyright (c) 2015-2016 Intel Corporation
 *
 * SPDX-License-Identifier: Apache-2.0
 */

#include <bluetooth/bluetooth.h>
#include <bluetooth/hci.h>
#include <device.h>
#include <drivers/gpio.h>
#include <zephyr/drivers/sensor.h>
#include <drivers/sensor.h>
#include <math.h>
#include <shell/shell.h>
#include <stddef.h>
#include <stdio.h>
#include <string.h>
#include <sys/__assert.h>
#include <sys/printk.h>
#include <sys/util.h>
#include <usb/usb_device.h>
#include <zephyr.h>
#include <zephyr/types.h>

/** Private Defines *******************************************/
#define PACKET_BUFFER_SIZE 31
#define DEVICE_NAME        CONFIG_BT_DEVICE_NAME
#define DEVICE_NAME_LEN    (sizeof(DEVICE_NAME) - 1)

/** Private Variables *****************************************/

uint8_t packetBuffer[PACKET_BUFFER_SIZE];

/* Prototypes ***********************************************/
void bluetooth_str_to_broadcast();

/* Private Structs ******************************************/

static void fetch_and_display(const struct device *sensor) {
    struct sensor_value accel[3];
    struct sensor_value gyro[3];
    int rc = sensor_sample_fetch(sensor);

    if (rc == 0) {
        rc = sensor_channel_get(sensor, SENSOR_CHAN_ACCEL_XYZ, accel);
        rc = sensor_channel_get(sensor, SENSOR_CHAN_GYRO_XYZ, gyro);
        float x_accel = (float)(sensor_value_to_double(&accel[0]));
        float y_accel = (float)(sensor_value_to_double(&accel[1]));
        float z_accel = (float)(sensor_value_to_double(&accel[2]));
        float x_gyro = (float)(sensor_value_to_double(&gyro[0]));
        float y_gyro = (float)(sensor_value_to_double(&gyro[1]));
        float z_gyro = (float)(sensor_value_to_double(&gyro[2]));

        uint8_t x_buff[4], y_buff[4], z_buff[4];
        memcpy(x_buff, &x_accel, sizeof(float));
        memcpy(y_buff, &y_accel, sizeof(float));
        memcpy(z_buff, &z_accel, sizeof(float));
        for (int i = 0; i < 4; i++) {
            packetBuffer[i + 2] = x_buff[i];
        }
        for (int i = 0; i < 4; i++) {
            packetBuffer[i + 6] = y_buff[i];
        }
        for (int i = 0; i < 4; i++) {
            packetBuffer[i + 10] = z_buff[i];
        }
        int x_count = 0;
        int y_count = 0;
        int z_count = 0;
        for (int i = 0; i < 4; i++) {
            if (packetBuffer[i] == x_buff[i]) {
                x_count++;
            }
            if (packetBuffer[i + 4] == y_buff[i]) {
                y_count++;
            }
            if (packetBuffer[i + 8] == z_buff[i]) {
                z_count++;
            }
        }
        uint8_t x_buff1[4], y_buff1[4], z_buff1[4];
        memcpy(x_buff1, &x_gyro, sizeof(float));
        memcpy(y_buff1, &y_gyro, sizeof(float));
        memcpy(z_buff1, &z_gyro, sizeof(float));
        for (int i = 0; i < 4; i++) {
            packetBuffer[i + 14] = x_buff1[i];
        }
        for (int i = 0; i < 4; i++) {
            packetBuffer[i + 18] = y_buff1[i];
        }
        for (int i = 0; i < 4; i++) {
            packetBuffer[i + 22] = z_buff1[i];
        }
        int x_count = 0;
        int y_count = 0;
        int z_count = 0;
        for (int i = 0; i < 4; i++) {
            if (packetBuffer[i+12] == x_buff1[i]) {
                x_count++;
            }
            if (packetBuffer[i + 16] == y_buff1[i]) {
                y_count++;
            }
            if (packetBuffer[i + 20] == z_buff1[i]) {
                z_count++;
            }
        }
#ifdef debug
        printf("X Buffer\n");
        for (int i = 0; i < 4; i++) {
            printf("%X:", x_buff[i]);
        }
        printf("\n");
        printf("Y Buffer\n");
        for (int i = 0; i < 4; i++) {
            printf("%X:", y_buff[i]);
        }
        printf("\n");
        printf("Z Buffer\n");
        for (int i = 0; i < 4; i++) {
            printf("%X:", z_buff[i]);
        }
        printf("\n");
        for (int i = 0; i < PACKET_BUFFER_SIZE; i++) {
            printf("%X:", packetBuffer[i]);
        }
        printf("\n");
#endif
        bluetooth_str_to_broadcast();
    } else if (rc < 0) {
        printf("ERROR: Update failed: %d\n", rc);
    }
}

/** Initial Struct **/
static const struct bt_data ad[] = {
    BT_DATA_BYTES(BT_DATA_FLAGS, BT_LE_AD_NO_BREDR),
    BT_DATA_BYTES(BT_DATA_UUID32_ALL, 0xaa, 0xfe),
    BT_DATA_BYTES(BT_DATA_SVC_DATA32, 0xaa, 0xfe, /* Eddystone UUID */
        0x10,                                     /* Eddystone-URL frame type */
        0x00, 0xAA, 0xAA, 0xAA, 0xFF, 0xFF, 0xaa, 0xfe, /* Eddystone UUID */
        0x10,                                     /* Eddystone-URL frame type */
        0x00, 0xAA, 0xAA, 0xAA, 0xFF, 0xFF)};

/** Scan Struct Information **/
static const struct bt_data sd[] = {
    BT_DATA(BT_DATA_NAME_COMPLETE, DEVICE_NAME, DEVICE_NAME_LEN),
};

#ifdef CONFIG_LIS2DH_TRIGGER
static void trigger_handler(
    const struct device *dev, struct sensor_trigger *trig) {
    fetch_and_display(dev);
}
#endif

/** Bluetooth ready callback **/
static void bt_ready(int err) {
    char addr_s[BT_ADDR_LE_STR_LEN];
    bt_addr_le_t addr = {0};
    size_t count = 1;

    if (err) {
        printk("Bluetooth init failed (err %d)\n", err);
        return;
    }

    printk("Bluetooth initialized\n");

    /* Start advertising */
    err = bt_le_adv_start(
        BT_LE_ADV_NCONN_IDENTITY, ad, ARRAY_SIZE(ad), sd, ARRAY_SIZE(sd));
    if (err) {
        printk("Advertising failed to start (err %d)\n", err);
        return;
    }

    /* For connectable advertising you would use
     * bt_le_oob_get_local().  For non-connectable non-identity
     * advertising an non-resolvable private address is used;
     * there is no API to retrieve that.
     */

    bt_id_get(&addr, &count);
    bt_addr_le_to_str(&addr, addr_s, sizeof(addr_s));

    printk("Beacon started, advertising as %s\n", addr_s);
}

void bluetooth_str_to_broadcast() {

    int err;

    /** Construct BT data **/
    const struct bt_data adNew[] = {
        BT_DATA_BYTES(BT_DATA_FLAGS, BT_LE_AD_NO_BREDR),
        BT_DATA_BYTES(BT_DATA_UUID16_ALL, 0xaa, 0xfe),
        BT_DATA_BYTES(BT_DATA_SVC_DATA16, packetBuffer[0], packetBuffer[1],
            packetBuffer[2], packetBuffer[3], packetBuffer[4], packetBuffer[5],
            packetBuffer[6], packetBuffer[7], packetBuffer[8], packetBuffer[9],
            packetBuffer[10], packetBuffer[11], packetBuffer[12],
            packetBuffer[13], packetBuffer[14], packetBuffer[15], packetBuffer[16], packetBuffer[17],
            packetBuffer[18], packetBuffer[19], packetBuffer[20], packetBuffer[21], packetBuffer[22],
            packetBuffer[23], packetBuffer[24])};

    /** Update info **/
    err = bt_le_adv_update_data(adNew, ARRAY_SIZE(adNew), sd, ARRAY_SIZE(sd));
    if (err) {
        printk("We have encountered the error %d while trying to update "
               "the ble data\r\n",
            err);
    }
}

void main(void) {

    /** Try to bind to the accelerometor **/
    // const struct device *sensor =
    //     device_get_binding(DT_LABEL(DT_INST(0, st_lis2dh)));
    
	const struct device *const sensor = DEVICE_DT_GET_ONE(st_lis2dh);

    if (sensor == NULL) {
        printf("Could not get %s device\n", DT_LABEL(DT_INST(0, st_lis2dh)));
        return;
    }

	// Set sensor values
	struct sensor_value odr_attr;
	odr_attr.val1 = 104;
	odr_attr.val2 = 0;
	if (!device_is_ready(sensor)) {
		printk("sensor: device not ready.\n");
		return;
	}

	if (sensor_attr_set(sensor, SENSOR_CHAN_ACCEL_XYZ,
			SENSOR_ATTR_SAMPLING_FREQUENCY, &odr_attr) < 0) 
	{
		printk("Cannot set sampling frequency for accelerometer.\n");
		return;
	}

	if (sensor_attr_set(sensor, SENSOR_CHAN_GYRO_XYZ,
				SENSOR_ATTR_SAMPLING_FREQUENCY, &odr_attr) < 0) {
		printk("Cannot set sampling frequency for gyro.\n");
		return;
	}


    int err;

    /* Initialize the Bluetooth Subsystem */
    err = bt_enable(bt_ready);
    if (err) {
        printk("Bluetooth init failed (err %d)\n", err);
        return;
    }

    printf("Polling at 0.5 Hz\n");
    while (true) {
        fetch_and_display(sensor);
        k_sleep(K_MSEC(2000));
    }

}

// #if CONFIG_LIS2DH_TRIGGER
//     {
//         struct sensor_trigger trig;
//         int rc;

//         trig.type = SENSOR_TRIG_DATA_READY;
//         trig.chan = SENSOR_CHAN_ACCEL_XYZ;

//         if (IS_ENABLED(CONFIG_LIS2DH_ODR_RUNTIME)) {
//             struct sensor_value odr = {
//                 .val1 = 1,
//             };

//             rc = sensor_attr_set(
//                 sensor, trig.chan, SENSOR_ATTR_SAMPLING_FREQUENCY, &odr);
//             if (rc != 0) {
//                 printf("Failed to set odr: %d\n", rc);
//                 return;
//             }
//             printf("Sampling at %u Hz\n", odr.val1);
//         }

//         rc = sensor_trigger_set(sensor, &trig, trigger_handler);
//         if (rc != 0) {
//             printf("Failed to set trigger: %d\n", rc);
//             return;
//         }

//         printf("Waiting for triggers\n");
//         while (true) {
//             k_sleep(K_MSEC(2000));
//         }
    }
// #else /* CONFIG_LIS2DH_TRIGGER */
```

## src/nodes.c
```c
#include <nodes.h>
#include <shell/shell.h>
#include <sys/slist.h>
#include <kernel.h>

#include <stdlib.h>
#include <stdio.h>

/* Stores the list of nodes in a single linked list */
sys_slist_t node_list;

/* Stores the list of active nodes based on thier coordinates */
int active_nodes[12] = {
	NODE_A_ID, 
	NODE_B_ID, 
	NODE_C_ID, 
	NODE_D_ID, 
	NODE_E_ID, 
	NODE_F_ID, 
	NODE_G_ID, 
	NODE_H_ID
};

void print_activenodes(int16_t rx_rssi[]){
	extern int active_nodes[];
	printk("^%d,%d,%d,%d,%d,%d,%d,%d,%d,%d,%d,%d~", rx_rssi[0], rx_rssi[1], rx_rssi[2], rx_rssi[3],  
	rx_rssi[4], rx_rssi[5], rx_rssi[6], rx_rssi[7], rx_rssi[8], rx_rssi[9], rx_rssi[10], rx_rssi[11]);
	// printk("%d,%d,%d,%d,%d,%d,%d,%d,%d,%d,%d,%d", active_nodes[0], active_nodes[1], 
	// 	active_nodes[2], active_nodes[3], active_nodes[4], active_nodes[5],  
	// 	active_nodes[6], active_nodes[7], active_nodes[8], active_nodes[9], active_nodes[10], active_nodes[11]);
	// for(int j = 0; j < 12; j++){
	// 	printk("%d,",active_nodes[j]);
	// }
}

/* Stores the linked list nodes with additional data */
struct data_node {
	sys_snode_t node;
	int* data;
	int* x;
	int* y;
};

/* Stores the static information of a nodes */
typedef struct Node_Struct {
	char* name;
	char* address;
	int major_num;
	int minor_num;
} Node_Struct;

/* Stores the information of all 12 nodes */
Node_Struct node_all[12] = {
	{"4011-A", "F5:75:FE:85:34:67", 2753, 32998},
	{"4011-B", "E5:73:87:06:1E:86", 32975, 20959},
	{"4011-C", "CA:99:9E:FD:98:B1", 26679, 40363},
	{"4011-D", "CB:1B:89:82:FF:FE", 41747, 38800},
	{"4011-E", "D4:D2:A0:A4:5C:AC", 30679, 51963},
	{"4011-F", "C1:13:27:E9:B7:7C", 6195, 18394},
	{"4011-G", "F1:04:48:06:39:A0", 30525, 30544},
	{"4011-H", "CA:0C:E0:DB:CE:60", 57395, 28931},
	{"4011-I", "D4:7F:D4:7C:20:13", 60345, 49995},
	{"4011-J", "F7:0B:21:F1:C8:E1", 12249, 30916},
	{"4011-K", "FD:E0:8D:FA:3E:4A", 36748, 11457},
	{"4011-L", "EE:32:F7:28:FA:AC", 27564, 27589}
};

/**
 * @brief Update active_node array based on given nodes' coordinates
 */
void update_active_nodes(void) {
	for (int i = 1; i <= 12; i++) {
		switch(get_node_x(i)) {
			case 0:
				switch(get_node_y(i)) {
					case 0:
						active_nodes[NODE_POSITION_ONE] = i;
						break;
					case 2:
						active_nodes[NODE_POSITION_EIGHT] = i;
						break;
					case 4:
						active_nodes[NODE_POSITION_SEVEN] = i;
						break;
					default:
						printk("Error at node update\n");
				}
				break;
			case 2:
				switch(get_node_y(i)) {
					case 0:
						active_nodes[NODE_POSITION_TWO] = i;
						break;
					case 4:
						active_nodes[NODE_POSITION_SIX] = i;
						break;
					default:
						printk("Error at node update\n");
				}
				break;
			case 4:
				switch(get_node_y(i)) {
					case 0:
						active_nodes[NODE_POSITION_THREE] = i;
						break;
					case 2:
						active_nodes[NODE_POSITION_FOUR] = i;
						break;
					case 4:
						active_nodes[NODE_POSITION_FIVE] = i;
						break;
					default:
						printk("Error at node update\n");
				}
		}
	}
}

/**
 * @brief Takes a node as the target and find the next node in the list
 * 
 * @param target : the target node to check for
 * 
 * @returns : next node in the list
 */
sys_snode_t* get_next_node(sys_snode_t* target) {
	if (target == sys_slist_peek_tail(&node_list)) {
		return sys_slist_peek_head(&node_list);
	}
	return sys_slist_peek_next(target);
}

/**
 * @brief Takes a node as the target and find the last node in the list
 * 
 * @param target : the target node to check for
 * 
 * @returns : last node in the list
 */
sys_snode_t* get_last_node(sys_snode_t* target) {
	sys_snode_t* head_node = sys_slist_peek_head(&node_list);
	sys_snode_t* tail_node = sys_slist_peek_tail(&node_list);
	sys_snode_t* last_node = NULL;
	if (head_node == tail_node) {
		return head_node;
	}
	if (target == head_node) {
		return tail_node;
	} 
	while (true) {
		last_node = head_node;
		head_node = sys_slist_peek_next(head_node);
		if (target == head_node) {
			return last_node;
		}
		if (head_node == sys_slist_peek_tail(&node_list)) {
			return NULL;
		}
	}
}

/**
 * @brief Takes a node id and attempt to fond the node
 * 
 * @param node_id : the node id to search for
 * 
 * @returns : node id's node
 */
sys_snode_t* find_node(int node_id) {
	if (node_id < 1 || node_id > 12) {
		return 0;
	}
	sys_snode_t* node = sys_slist_peek_head(&node_list);
	while (true) {
		int node_number = *((struct data_node *)node)->data;
		if (node_id == node_number) {
			return node;
		}
		if (node != sys_slist_peek_tail(&node_list)) {
			node = sys_slist_peek_next(node);
		} else {
			return 0;
		}
	}
	return 0;
}

/**
 * @brief Initialise a data_node struct allocating memories
 * 
 * @returns : the initialised data_node struct
 */
struct data_node* data_node_init(void) {
	struct data_node* node;
	node = (struct data_node*)k_malloc(sizeof(struct data_node));
	node->data = (int*)k_malloc(sizeof(int));
	node->x = (int*)k_malloc(sizeof(int));
	node->y = (int*)k_malloc(sizeof(int));
	return node;
}

/**
 * @brief Free a data_node struct's memories
 * 
 * @param node : the struct to free
 */
void data_node_free(sys_snode_t* node) {
	k_free(((struct data_node*)node)->data);
	k_free(((struct data_node*)node)->x);
	k_free(((struct data_node*)node)->y);
	k_free(node);
}

/**
 * @brief Takes a node id and print all the node infos without neighbour infos
 * 
 * @param node_id : the node id to check for
 */
void print_node_info(int node_id) {
	sys_snode_t* node = find_node(node_id);
	int x = *((struct data_node*)node)->x;
	int y = *((struct data_node*)node)->y;
	printk("Node ID: %d has the following properties:\n", node_id);
	printk("Node name: %s\n", node_all[node_id-1].name);
	printk("Node MAC Address: %s\n", node_all[node_id-1].address);
	printk("Node major number: %d\n", node_all[node_id-1].major_num);
	printk("Node minor number: %d\n", node_all[node_id-1].minor_num);
	printk("Node X coordinate: %d\n", x);
	printk("Node Y coordinate: %d\n", y);
}

/**
 * @brief Print the node neightbour information into the shell. Left being
 * 		  the node before the target on the linked list and right being the
 * 		  node after the target 
 * 
 * @param node_id : the id of the node to check for neighbours
 */
void print_node_neighbours(int node_id) {
	sys_snode_t* node = find_node(node_id);
	sys_snode_t* next_node = get_next_node(node);
	sys_snode_t* last_node = get_last_node(node);
	int next_id = *((struct data_node*)next_node)->data;
	int last_id = *((struct data_node*)last_node)->data;
	printk("Node left neighbour: %s\n", node_all[last_id-1].name);
	printk("Node right neighbour: %s\n", node_all[next_id-1].name);
}

/**
 * @brief Takes the data, x and y values to create a new node
 * 
 * @param data : the data passed to the data_node struct
 * @param x : the x passed to the data_node struct
 * @param y : the y passed to the data_node struct
 * 
 * @returns : next node in the list
 */
void add_node(int data, int x, int y) {
	struct data_node* data_node = data_node_init();
	*data_node->data = data;
	*data_node->x = x;
	*data_node->y = y;
	sys_slist_append(&node_list, &data_node->node);
	update_active_nodes();
}

/**
 * @brief handler for add new nodes function
 * 
 * @param sh : the shell
 * @param argc : number of arguments
 * @param argv : the arguments
 * 
 * @returns : 0 on success
 */
static int add_node_handler(const struct shell *sh, size_t argc, char **argv) {
	ARG_UNUSED(sh);
	ARG_UNUSED(argc);
	ARG_UNUSED(argv);
	int node_number = atoi(argv[1]);
	int node_x = atoi(argv[2]);
	int node_y = atoi(argv[3]);
	if (node_number < 1 || node_number > 12) {
		printk("Invalid node id\n");
		return 0;
	}
	if (find_node(node_number)) {
		printk("Node already exist\n");
		return 0;
	}
	add_node(node_number, node_x, node_y);
	printk("Added the following node\n");
	print_node_info(node_number);
	return 0;
}

/**
 * @brief handler for remove nodes function
 * 
 * @param sh : the shell
 * @param argc : number of arguments
 * @param argv : the arguments
 * 
 * @returns : 0 on success
 */
static int remove_node_handler(const struct shell *sh, size_t argc, char **argv) {
	ARG_UNUSED(sh);
	ARG_UNUSED(argc);
	ARG_UNUSED(argv);
	int node_number = atoi(argv[1]);
	sys_snode_t* node;
	if ((node = find_node(node_number))) {
		sys_slist_find_and_remove(&node_list, node);
		data_node_free(node);
		printk("Node %d removed\n", node_number);
		return 0;
	} else {
		printk("Node doesn't exist\n");
	}
	return 0;
}

/**
 * @brief handler for displaying nodes function. display one or all nodes
 * 
 * @param sh : the shell
 * @param argc : number of arguments
 * @param argv : the arguments
 * 
 * @returns : 0 on success
 */
static int get_node_handler(const struct shell *sh, size_t argc, char **argv) {
	ARG_UNUSED(sh);
	ARG_UNUSED(argc);
	ARG_UNUSED(argv);
	char* node_name = argv[1];
    if (sys_slist_is_empty(&node_list)) {
        printk("Node list is empty\n");
    } else {
		if (strcmp(node_name, "all") == 0) {
			sys_snode_t* node = sys_slist_peek_head(&node_list);
			while (true) {
				int node_number = *((struct data_node*)node)->data;
				print_node_info(node_number);
				print_node_neighbours(node_number);
				if (node != sys_slist_peek_tail(&node_list)) {
					node = sys_slist_peek_next(node);
				} else {
					break;
				}
			}
		} else {
			int node_id = atoi(node_name);
			if (!find_node(node_id)) {
				printk("No such node was found\n");
			} else {
				print_node_info(node_id);
				print_node_neighbours(node_id);
				for (int i = 0; i < 8; i++) {
					printk("Active Nodes is %d\n", active_nodes[i]);
				}
			}
		} 
    }
	return 0;
}

/**
 * @brief Initialise all the default nodes and their positions (A - H)
 */
void default_nodes_init(void) {
	add_node(NODE_A_ID, 0, 0);
	add_node(NODE_B_ID, 2, 0);
	add_node(NODE_C_ID, 4, 0);
	add_node(NODE_D_ID, 4, 2);
	add_node(NODE_E_ID, 4, 4);
	add_node(NODE_F_ID, 2, 4);
	add_node(NODE_G_ID, 0, 4);
	add_node(NODE_H_ID, 0, 2);
}

/**
 * @brief Initialise shell commands and node list and default nodes
 */
void node_list_cmd_init(void) {
    sys_slist_init(&node_list);
	default_nodes_init();
    SHELL_STATIC_SUBCMD_SET_CREATE(
        node_handler,
        SHELL_CMD_ARG(add, NULL,
            "Add nodes to the list of nodes. command: node add [id] [x] [y]",
            &add_node_handler, 4, 0
        ),
		SHELL_CMD_ARG(remove, NULL,
			"Remove nodes from the list of nodes. command: node remove [id]",
			&remove_node_handler, 2, 0
		),
        SHELL_CMD_ARG(get, NULL,
			"Get node or nodes from the list of nodes. command: node get [id]",
			&get_node_handler, 2, 0
		),
        SHELL_SUBCMD_SET_END
    );
    SHELL_CMD_REGISTER(node, &node_handler,
		"Set node information", NULL
	);
}

/**
 * @brief Get the name of the node with node id
 * 
 * @return : name of the node
 */
char* get_node_name(int node_id) {
	return node_all[node_id-1].name;
}

/**
 * @brief Get the mac address of the node with node id
 * 
 * @return : mac address of the node
 */
char* get_node_mac(int node_id) {
	return node_all[node_id-1].address;
}

/**
 * @brief Get the x position of the node with node id
 * 
 * @return : x position  of the node
 */
int get_node_x(int node_id) {
	sys_snode_t* node = find_node(node_id);
	if (node == 0) {
		return -1;
	}
	return *((struct data_node*)node)->x;
}

/**
 * @brief Get the y position of the node with node id
 * 
 * @return : y position  of the node
 */
int get_node_y(int node_id) {
	sys_snode_t* node = find_node(node_id);
	if (node == 0) {
		return -1;
	}
	return *((struct data_node*)node)->y;
}
```

## src/nodes.h
```c
#ifndef NODES_H
#define NODES_H

#include <sys/slist.h>

/* Node ids */
#define NODE_A_ID 1
#define NODE_B_ID 2
#define NODE_C_ID 3
#define NODE_D_ID 4
#define NODE_E_ID 5
#define NODE_F_ID 6
#define NODE_G_ID 7
#define NODE_H_ID 8
#define NODE_I_ID 9
#define NODE_J_ID 10
#define NODE_K_ID 11
#define NODE_L_ID 12

/* Active nodes postions */
#define NODE_POSITION_ONE 		0
#define NODE_POSITION_TWO 		1
#define NODE_POSITION_THREE		2
#define NODE_POSITION_FOUR		3
#define NODE_POSITION_FIVE		4
#define NODE_POSITION_SIX		5
#define NODE_POSITION_SEVEN		6
#define NODE_POSITION_EIGHT		7

void print_activenodes(int16_t[]);

void node_list_cmd_init(void);

char* get_node_name(int);

char* get_node_mac(int);

int get_node_x(int);

int get_node_y(int);

#endif
```
