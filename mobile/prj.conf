## CMakeLists.txt
```
# SPDX-License-Identifier: Apache-2.0
#Setting to exclusively build for the Thingy
set(BOARD thingy52_nrf52832)
set(BOARD_FLASH_RUNNER jlink)
#set(DTC_OVERLAY_FILE boards/mpu9250.overlay)
set(CONF_FILE prj.conf rtt_console.conf bt.conf)

cmake_minimum_required(VERSION 3.13.1)
find_package(Zephyr REQUIRED HINTS $ENV{ZEPHYR_BASE})
project(mobile)

#Add include_directories for libraries, path starts from this files location.
include_directories(inc/ lib/)

target_sources(app PRIVATE src/main.c src/mobile_connect.c src/mobile_rssi.c src/mobile_imu.c lib/zephyr_i2c.c lib/inv_mpu.c lib/inv_mpu_dmp_motion_driver.c)
```

## prj.conf
```kconfig
                                #Console MISC
#------------------------------------------------------------------------------
CONFIG_GPIO=y
CONFIG_I2C=y
CONFIG_SENSOR=y
CONFIG_LIS2DH=y
CONFIG_CBPRINTF_FP_SUPPORT=y
```

## bt.conf
```kconfig
#------------------------------------------------------------------------------
                                #BT Config
#------------------------------------------------------------------------------
#BT On
CONFIG_BT=y
#Become an observer 
CONFIG_BT_OBSERVER=y
#BT Log Level Debug
CONFIG_BT_DEBUG_LOG=y

CONFIG_BT_DEVICE_NAME="Thingy_2"
#Enable support for the Security Manager Protocol (SMP), making it possible to pair devices over LE.
CONFIG_BT_SMP=y
#Enable data signing which is used for transferring authenticated data in an unencrypted connection.
CONFIG_BT_SIGNING=y
#Select this for LE Peripheral role support
CONFIG_BT_PERIPHERAL=y
#Enable GATT Device Information service
CONFIG_BT_DIS=y
#Enable local Privacy Feature support. This makes it possible to use Resolvable Private Addresses (RPAs).
CONFIG_BT_PRIVACY=y
#Bluetooth device appearance. 
CONFIG_BT_DEVICE_APPEARANCE=833
CONFIG_BT_FIXED_PASSKEY=y

# Set the BLE to transmit with +4dbm power
CONFIG_BT_CTLR_TX_PWR_PLUS_8=y

CONFIG_BT_CONN_TX_MAX=16
#CONFIG_BT_CTLR_TX_BUFFERS=16

CONFIG_I2C_LOG_LEVEL_DBG=y
CONFIG_LOG=y
```

## src/main.c
```c
#include <kernel.h>
#include <device.h>
#include <devicetree.h>
#include <drivers/gpio.h>
#include <data/json.h>

#include <bluetooth/bluetooth.h>
#include <bluetooth/hci.h>
/**
 ************************************************************************
 * @file main.c
 * @author Ethan Von de Vegt and SongYuan Wang
 * @date 27.04.2023
 * @brief Mobile connection to static nodes and base
 **********************************************************************
 **/

#include <bluetooth/conn.h>
#include <bluetooth/uuid.h>
#include <bluetooth/gatt.h>

#include <init.h>
#include <drivers/gpio.h>
#include <sys/printk.h>

#include "mobile_connect.h"
#include "mobile_imu.h"

/*
    west build -p -b thingy52_nrf52832 && west flash -r jlink
    JLinkExe -if SWD
    JLinkRTTClient
*/

/* Thingy LED blinking thread */
K_THREAD_DEFINE(led_blink, THREAD_LED_THREAD_STACK, thread_led, NULL, NULL, NULL, THREAD_PRIORITY_LED_THREAD, 0, 50);
/* Thingy RSSI scanner */
K_THREAD_DEFINE(ble_connect, THREAD_BLE_CONNECT_STACK, thread_ble_connect, NULL, NULL, NULL, THREAD_PRIORITY_BLE_CONNECT_THREAD, 0, 0);
```

## inc/mobile_connect.h
```c
#ifndef MOBILE_CONNECT_H
#define MOBILE_CONNECT_H

/* Debug Thread Stack size */
#define THREAD_LED_THREAD_STACK 1024
#define THREAD_BLE_CONNECT_STACK 2048
/* Debug Thread Priority */
#define THREAD_PRIORITY_LED_THREAD 20
#define THREAD_PRIORITY_BLE_CONNECT_THREAD -3
/* RSSI Values update */
extern uint16_t node_rssi[];

void thread_led(void);

extern int16_t imu_accel_raw[], imu_gyro_raw[];

void thread_ble_connect(void);

#endif
```

## inc/mobile_imu.h
```c
#ifndef MOBILE_IMU_H
#define MOBILE_IMU_H

/* Debug Thread Stack size */
#define THREAD_IMU_RW_STACK 2048
/* Debug Thread Priority */
#define THREAD_PRIORITY_IMU -1

void thread_imu_rw(void);

//Functions

void thread_imu_rw(void);

/* IMU FUNCTIONS */
float getGyroSens(void);

unsigned short getAccelSens(void);

int setSensors(unsigned char sensors);

unsigned short getAccelSens(void);

int updateAccel(void);

int updateGyro(void);

int updateCompass(void);

int setGyroFSR(unsigned short fsr);

int setAccelFSR(unsigned char fsr);

int setLPF(unsigned short lpf);

int setSampleRate(unsigned short rate);

int setCompassSampleRate(unsigned short rate);

bool dataReady(void);

int update(unsigned char sensors);

float calcAccel(int axis);

float calcGyro(int axis);

float calcMag(int axis);

int updateTemperature(void);

int begin(void);

void printIMUData(void);

int dmpLoad(void);

int dmpBegin(unsigned short features, unsigned short fifoRate);

int dmpEnableFeatures(unsigned short mask);

int dmpSetFifoRate(unsigned short rate);

int dmpSetPedometerSteps(unsigned long steps);

int dmpSetPedometerTime(unsigned long time);

unsigned long dmpGetPedometerTime(void);

unsigned long dmpGetPedometerSteps(void);

int dmpBegin(unsigned short features, unsigned short fifoRate);


#endif
```

## inc/mobile_rssi.h
```c
#ifndef MOBILE_RSSI_H
#define MOBILE_RSSI_H

#include <zephyr.h>

// Stack size for thread_ble_scan
#define STACK_SIZE_BLE_SCAN                                         1024
// Thread priority for thread_ble_scan
#define THREAD_PRIORITY_BLE_SCAN                                    3
// Stack size for thread_ble_send
#define STACK_SIZE_BLE_SEND                                         1024
// Thread priority for thread_ble_send
#define THREAD_PRIORITY_BLE_SEND                                    7
// Maximum possible BLE GAP name length
#define BLE_MAX_NAME_LEN                                            50
// Number of static nodes
#define STATIC_NODE_NUM                                             12
//Using 280ms period ensures packets aren't lost.
#define MOBILE_BASE_SCAN_PERIOD                                     280

// Holds all data relevant to a scanned node advertisement
struct NodeData {
    char name[BLE_MAX_NAME_LEN];
    uint16_t rssi;
};

// Thread to scan for advertisements
void thread_ble_scan(void);

// Thread to display node data
void thread_ble_send(void);

#endif
```

## src/mobile_connect.c
```c
#include <kernel.h>
#include <device.h>
#include <zephyr.h>
#include <devicetree.h>
#include <drivers/gpio.h>
#include <drivers/sensor.h>

#include <bluetooth/bluetooth.h>
#include <bluetooth/hci.h>
#include <bluetooth/conn.h>
#include <bluetooth/uuid.h>
#include <bluetooth/gatt.h>
#include <sys/byteorder.h>

#include "mobile_connect.h"

/* The devicetree node identifier for the "led0" alias. */
#define LED0_NODE DT_ALIAS(led0)
/* LED sleep time */
#define SLEEP_TIME_MS                                                                   2000
/* Connection thread sleep time */
#define SHORT_SLEEP_MS                                                                  50
/* Device information */
#define DEVICE_NAME        CONFIG_BT_DEVICE_NAME
#define DEVICE_NAME_LEN    (sizeof(DEVICE_NAME) - 1)
/* Sensor value buffer */
#define SENSOR_BUFFER_SIZE 15

/* Set LED pins */
static const struct gpio_dt_spec led = GPIO_DT_SPEC_GET(LED0_NODE, gpios);

/* Set sub advertisement data */
static const struct bt_data sd[] = {
    BT_DATA(BT_DATA_NAME_COMPLETE, DEVICE_NAME, DEVICE_NAME_LEN),
};

/* Sensor value buffer */
int16_t sensor_read_buffer[SENSOR_BUFFER_SIZE];

void sensor_broadcast();

/* Set advertising data */
static const struct bt_data ad[] = {
    BT_DATA_BYTES(BT_DATA_FLAGS, (BT_LE_AD_GENERAL | BT_LE_AD_NO_BREDR)),
    BT_DATA_BYTES(BT_DATA_UUID128_ALL,
                  0xd0, 0x92, 0x67, 0x35, 0x78, 0x16, 0x21, 0x91,
                  0x26, 0x49, 0x60, 0xeb, 0x06, 0xa7, 0xca, 0xcd),
};

/**
 * @brief Takes a sensor and read its accelerometer values, then call BLE function to broadcast
 * 
 * @param sensor : device sensor to be read value off
 * 
 */
static void fetch_and_display(const struct device *sensor) {
	static unsigned int count;
	struct sensor_value accel[3];
	struct sensor_value temperature;
	const char *overrun = "";
	int rc = sensor_sample_fetch(sensor);
	++count;
	if (rc == -EBADMSG) {
		if (IS_ENABLED(CONFIG_LIS2DH_TRIGGER)) {
			overrun = "[OVERRUN] ";
		}
		rc = 0;
	}
	if (rc == 0) {
		rc = sensor_channel_get(sensor,
					SENSOR_CHAN_ACCEL_XYZ,
					accel);
	}
	if (rc < 0) {
		printk("ERROR: Update failed: %d\n", rc);
	} else {
		printk("#%u @ %u ms: %sx %f , y %f , z %f",
		       count, k_uptime_get_32(), overrun,
		       sensor_value_to_double(&accel[0]),
		       sensor_value_to_double(&accel[1]),
		       sensor_value_to_double(&accel[2]));
        float x_accel = (float)(sensor_value_to_double(&accel[0]));
        float y_accel = (float)(sensor_value_to_double(&accel[1]));
        float z_accel = (float)(sensor_value_to_double(&accel[2]));
        uint8_t x_buff[4], y_buff[4], z_buff[4];
        memcpy(x_buff, &x_accel, sizeof(float));
        memcpy(y_buff, &y_accel, sizeof(float));
        memcpy(z_buff, &z_accel, sizeof(float));
        for (int i = 0; i < 4; i++) {
            sensor_read_buffer[i + 2] = x_buff[i];
            printk("%d\n", x_buff[i]);
        }
        for (int i = 0; i < 4; i++) {
            sensor_read_buffer[i + 6] = y_buff[i];
        }
        for (int i = 0; i < 4; i++) {
            sensor_read_buffer[i + 10] = z_buff[i];
        }
        sensor_broadcast();
	}
}

/**
 * @brief Initialises bluetooth, and begins advertising data on BLE.
 * 
 */
static void bt_ready(void) {
    int err;
    bt_addr_le_t addr = {0};
    size_t count = 1;
    char addr_s[BT_ADDR_LE_STR_LEN];
    printk("Bluetooth initialized\n");
    err = bt_le_adv_start(
        BT_LE_ADV_NCONN_IDENTITY, ad, ARRAY_SIZE(ad), sd, ARRAY_SIZE(sd));
    if (err) {
        printk("Advertising failed to start (err %d)\n", err);
        return;
    }
    bt_id_get(&addr, &count);
    bt_addr_le_to_str(&addr, addr_s, sizeof(addr_s));
    printk("Advertising successfully started\n");
}

/**
 * @brief Display sensor data using the sensor buffer. Display as advertisement
 * 
 */
void sensor_broadcast() {
    int err;
    const struct bt_data adNew[] = {
        BT_DATA_BYTES(BT_DATA_FLAGS, BT_LE_AD_NO_BREDR),
        BT_DATA_BYTES(BT_DATA_UUID16_ALL, 0xaa, 0xfe),
        BT_DATA_BYTES(BT_DATA_SVC_DATA16, sensor_read_buffer[0], sensor_read_buffer[1],
            sensor_read_buffer[2], sensor_read_buffer[3], sensor_read_buffer[4], sensor_read_buffer[5],
            sensor_read_buffer[6], sensor_read_buffer[7], sensor_read_buffer[8], sensor_read_buffer[9],
            sensor_read_buffer[10], sensor_read_buffer[11], sensor_read_buffer[12],
            sensor_read_buffer[13], sensor_read_buffer[14])};
    err = bt_le_adv_update_data(adNew, ARRAY_SIZE(adNew), sd, ARRAY_SIZE(sd));
    if (err) {
        printk("We have encountered the error %d while trying to update "
               "the ble data\r\n",
            err);
    }
}

/* Config for sensor device */
#ifdef CONFIG_LIS2DH_TRIGGER
static void trigger_handler(const struct device *dev,
			    const struct sensor_trigger *trig)
{
	fetch_and_display(dev);
}
#endif

/**
 * @brief Enabled bluetooth and get sensor device. Call sensor to update values on repeat
 * 
 */
void thread_ble_connect(void) {
    const struct device *sensor = DEVICE_DT_GET_ANY(st_lis2dh);
    if (sensor == NULL) {
		printk("No device found\n");
		return;
	}
	if (!device_is_ready(sensor)) {
		printk("Device %s is not ready\n", sensor->name);
		return;
	}
    int err = bt_enable(bt_ready);
    if (err) {
        printk("Bluetooth init failed (err %d)\n", err);
        return;
    }
#if CONFIG_LIS2DH_TRIGGER 
    {
		struct sensor_trigger trig;
		int rc;
		trig.type = SENSOR_TRIG_DATA_READY;
		trig.chan = SENSOR_CHAN_ACCEL_XYZ;
		if (IS_ENABLED(CONFIG_LIS2DH_ODR_RUNTIME)) {
			struct sensor_value odr = {
				.val1 = 1,
			};
			rc = sensor_attr_set(sensor, trig.chan,
					     SENSOR_ATTR_SAMPLING_FREQUENCY,
					     &odr);
			if (rc != 0) {
				printf("Failed to set odr: %d\n", rc);
				return;
			}
			printk("Sampling at %u Hz\n", odr.val1);
		}
		rc = sensor_trigger_set(sensor, &trig, trigger_handler);
		if (rc != 0) {
			printk("Failed to set trigger: %d\n", rc);
			return;
		}
		printf("Waiting for triggers\n");
		while (true) {
			k_sleep(K_MSEC(2000));
		}
	}
#else
	printk("Polling at 0.5 Hz\n");
	while (true) {
		fetch_and_display(sensor);
		k_sleep(K_MSEC(2000));
	}
#endif 
}

/**
 * @brief Debug blink led thread, blinks LED based on conenction status.
 * 
 */
void thread_led(void) {
    int ret;
	if (!device_is_ready(led.port)) {
		return;
	}
	ret = gpio_pin_configure_dt(&led, GPIO_OUTPUT_ACTIVE);
	if (ret < 0) {
		return;
	}
	while (1) {
		ret = gpio_pin_toggle_dt(&led);
		if (ret < 0) {
			return;
		}
		k_msleep(SLEEP_TIME_MS);
	}
}
```

## src/mobile_imu.c
```c
#include <init.h>
#include <drivers/gpio.h>
#include <sys/printk.h>
#include <drivers/i2c.h>
#include <logging/log.h>
#include <stdio.h>
#include <math.h>

#include "mobile_imu.h"
#include "inv_mpu.h"
#include "inv_mpu_dmp_motion_driver.h"
#include "imu_driver_defines.h"
#include "dmpKey.h"
#include "dmpmap.h"
#include "MPU9250_RegisterMap.h"
#include "mobile_connect.h"

LOG_MODULE_REGISTER(IMU_Driver, LOG_LEVEL_ERR);

#define MPU9250_ADDR 0x68
#define MPU9250_WHOAMI_ADDR 0x75

#define USER_CTRL_AD 0x6A
#define INT_BYPASS_CONFIG_AD 0x37

#define ACCEL_MODIFIER_X 50
#define ACCEL_MODIFIER_Y 70
#define ACCEL_MODIFIER_Z 16550

#define GYRO_MODIFIER_X 5
#define GYRO_MODIFIER_Y 16
#define GYRO_MODIFIER_Z 26

//MPU9250 is connected on i2c0 bus
#define I2C0 DT_LABEL(DT_NODELABEL(i2c0))

//Arduino Constraint
#define constrain(amt, low, high) ((amt) < (low) ? (low) : ((amt) > (high) ? (high) : (amt)))

struct sensorSens
{
    float mSense;
    float aSense;
    float gSense;
};

struct sensorSens mySens = {
    .mSense = 6.665f, // Constant - 4915 / 32760
    .aSense = 0.0f,   // Updated after accel FSR is set
    .gSense = 0.0f    // Updated after gyro FSR is set
};

// Global Senser Vals
unsigned long stepCount = 0;
unsigned long stepTime = 0;
unsigned long lastStepCount = 0;

/**
 * @brief Configures I2C_0 as master
 * 
 * @return int 0 if success
 */
int hal_i2c_configX(void)
{
    /* Obtain pre-initialised device binding - see device_config.h */
    const struct device *dev = device_get_binding(I2C0);

    if (dev == NULL)
    {
        printk("Could not get pointer to I2C2 device struct.\n");
    }

    if (!dev)
    {
        /* Unable to retrive device structure */
        return -ENODEV;
    }
    else
    {
        /*Configure I2C using attained device struct, using the following parameters */
        return i2c_configure(dev, I2C_SPEED_STANDARD | I2C_MODE_MASTER);
    }
}

/**
 * @brief Read and validate WHOAMI register on the MPU9250
 * 
 * @param reg regaddr to read
 * @param buffer buffer to save data into
 * @param size size of data
 * @return int 
 */
int hal_mpu9250_read_regX(uint8_t reg, uint8_t *buffer, int size)
{
    const struct device *dev = device_get_binding(I2C0);

    if (i2c_burst_read(dev, MPU9250_ADDR, reg, buffer, size) == 0)
    {
        return 0;
    }
    return -EIO;
}

/**
 * @brief Set the MPU bypass mode.
 * 
 */
void set_MPU_bypass_mode(void)
{
    hal_i2c_configX();
    const struct device *dev = device_get_binding(I2C0);

    uint8_t buffer;

    if (hal_mpu9250_read_regX(MPU9250_WHOAMI_ADDR, &buffer, sizeof(buffer)) == 0)
    {
        //Read Complete
        if (buffer == 0x71)
        {
            printk("MPU OK\n");
        }
    }

    //Disabled I2C Master Mode
    i2c_reg_write_byte(dev, MPU9250_ADDR, USER_CTRL_AD, 0x00);
    //Turn Bypass MUX on
    i2c_reg_write_byte(dev, MPU9250_ADDR, INT_BYPASS_CONFIG_AD, 0x02);

    //Read AK89XX ACK In Bypass
    i2c_reg_read_byte(dev, 0x0C, 0x00, &buffer);

    if (buffer == 0x48)
    {
        printk("AK8963 OK\n");
    }

    if (hal_mpu9250_read_regX(MPU9250_WHOAMI_ADDR, &buffer, sizeof(buffer)) == 0)
    {
        //Read Complete
        if (buffer == 0x71)
        {
            printk("MPU OK\n");
        }
    }

    //Read AK89XX ACK In Bypass
    i2c_reg_read_byte(dev, 0x0C, 0x00, &buffer);

    if (buffer == 0x48)
    {
        printk("AK8963 OK\n");
    }
}

/**
 * @brief Main thread that handles communication with the IMU Driver.
 * 
 */
void thread_imu_rw(void)
{
    //Set MPU9250 slave bypass MUX
    set_MPU_bypass_mode();

    if (begin() != INV_SUCCESS)
    {
        printk("Error\n");
        return;
    }

    while (1)
    {
        if (dataReady())
        {

            update(UPDATE_ACCEL | UPDATE_GYRO);
            printIMUData();
        }

        k_msleep(10);
    }
}

/**
 * @brief Initialise IMU
 * 
 * @return int ERRVAL
 */
int begin(void) {
    struct int_param_s int_param;
    int result;
    hal_i2c_configX();
    // Place all slaves (including compass) on primary bus
    if (mpu_set_bypass(1) != 0) {
        printk("Slave Error\n");
    }
    k_msleep(10);
    result = mpu_init(&int_param);
    if (result) {
        printk("Init Fail\n");
        return result;
    }

    setSensors(INV_XYZ_GYRO | INV_XYZ_ACCEL);
    mySens.gSense = getGyroSens();
    mySens.aSense = getAccelSens();
    printk("gSense: %f, aSense: %f\n", mySens.gSense, mySens.aSense);
    //Set Sensor Config
    // Use setGyroFSR() and setAccelFSR() to configure the
    // gyroscope and accelerometer full scale ranges.
    // Gyro options are +/- 250, 500, 1000, or 2000 dps
    setGyroFSR(2000); // Set gyro to 2000 dps
    // Accel options are +/- 2, 4, 8, or 16 g
    setAccelFSR(2); // Set accel to +/-2g
    // Note: the MPU-9250's magnetometer FSR is set at
    // +/- 4912 uT (micro-tesla's)

    // setLPF() can be used to set the digital low-pass filter
    // of the accelerometer and gyroscope.
    // Can be any of the following: 188, 98, 42, 20, 10, 5
    // (values are in Hz).
    setLPF(5); // Set LPF corner frequency to 5Hz

    // The sample rate of the accel/gyro can be set using
    // setSampleRate. Acceptable values range from 4Hz to 1kHz
    setSampleRate(10); // Set sample rate to 10Hz
    return result;
}

/**
 * @brief Sets IMU Data to buffer.
 * 
 */
void printIMUData(void)
{
    imu_accel_raw[0] = ax;
    imu_accel_raw[1] = ay;
    imu_accel_raw[2] = az;
    imu_gyro_raw[0] = gx;
    imu_gyro_raw[1] = gy;
    imu_gyro_raw[2] = gz;
}

/**
 * @brief Updates IMU sensor values
 * 
 * @param sensors sensors to select
 * @return int ERRVAL
 */
int update(unsigned char sensors) {
    int aErr = INV_SUCCESS;
    int gErr = INV_SUCCESS;
    if (sensors & UPDATE_ACCEL)
        aErr = updateAccel();
    if (sensors & UPDATE_GYRO)
        gErr = updateGyro();
    return aErr | gErr;
}

/**
 * @brief Detect if new data is ready
 * 
 * @return true data ready
 * @return false data not ready
 */
bool dataReady(void)
{
    unsigned char intStatusReg;

    if (mpu_read_reg(MPU9250_INT_STATUS, &intStatusReg) == INV_SUCCESS)
    {
        return (intStatusReg & (1 << INT_STATUS_RAW_DATA_RDY_INT));
    }
    return false;
}

/**
 * @brief Set the MPU sample rate
 * 
 * @param rate sample rate
 * @return int ERR
 */
int setSampleRate(unsigned short rate)
{
    return mpu_set_sample_rate(rate);
}

/**
 * @brief Set MPU low pass filter
 * 
 * @param lpf lpf value
 * @return int ERR
 */
int setLPF(unsigned short lpf)
{
    return mpu_set_lpf(lpf);
}

/**
 * @brief Set the Accel FSR
 * 
 * @param fsr FSR val
 * @return int ERR
 */
int setAccelFSR(unsigned char fsr)
{
    int err;

    err = mpu_set_accel_fsr(fsr);
    if (err == INV_SUCCESS)
    {
        mySens.aSense = getAccelSens();
    }
    return err;
}

/**
 * @brief Set the Gyro FSR
 * 
 * @param fsr fsr val
 * @return int ERR
 */
int setGyroFSR(unsigned short fsr)
{
    int err;

    err = mpu_set_gyro_fsr(fsr);
    if (err == INV_SUCCESS)
    {
        mySens.gSense = getGyroSens();
    }
    return err;
}

/**
 * @brief Set the Sensors on
 * 
 * @param sensors which sensors
 * @return int ERR
 */
int setSensors(unsigned char sensors)
{
    return mpu_set_sensors(sensors);
}

/**
 * @brief Get the Gyro Sens 
 * 
 * @return float sens
 */
float getGyroSens(void)
{
    float sens;
    if (mpu_get_gyro_sens(&sens) == INV_SUCCESS)
    {
        return sens;
    }
    return 0;
}

/**
 * @brief Get the Accel Sens 
 * 
 * @return unsigned short sens
 */
unsigned short getAccelSens(void)
{
    unsigned short sens;

    if (mpu_get_accel_sens(&sens) == INV_SUCCESS)
    {
        return sens;
    }
    return 0;
}

/**
 * @brief Updata accel info
 * 
 * @return int ERR
 */
int updateAccel(void)
{
    short data[3];

    if (mpu_get_accel_reg(data, &time))
    {
        return INV_ERROR;
    }
    ax = data[X_AXIS];
    ay = data[Y_AXIS];
    az = data[Z_AXIS];
    return INV_SUCCESS;
}
/**
 * @brief Update Gyro info
 * 
 * @return int ERR
 */
int updateGyro(void)
{
    short data[3];

    if (mpu_get_gyro_reg(data, &time))
    {
        return INV_ERROR;
    }
    gx = data[X_AXIS];
    gy = data[Y_AXIS];
    gz = data[Z_AXIS];
    return INV_SUCCESS;
}

//!SX150B POWER MPU9250 DEVICE ON AT BOOT------DON'T TOUCH----------------START
struct pwr_ctrl_cfg
{
    const char *port;
    uint32_t pin;
};

/**
 * @brief Generic power control function attained from
 *          thingy52/board.c
 * 
 * @param dev device handles
 * @return int return ERR val
 */
static int mpu_ctrl_init(const struct device *dev)
{
    const struct pwr_ctrl_cfg *cfg = dev->config;
    const struct device *gpio;

    gpio = device_get_binding(cfg->port);
    if (!gpio)
    {
        LOG_ERR("Could not bind device \"%s\"\n", cfg->port);
        return -ENODEV;
    }

    gpio_pin_configure(gpio, cfg->pin, GPIO_OUTPUT_HIGH);

    //Delay is required for the i2c rail to stabalize
    k_sleep(K_MSEC(100));

    return 0;
}

// Power up Thingy52 MPU9250 (analog switch) using SX1509B
#define MPU6050_VDD_PWR_CTRL_GPIO_PIN 8
static const struct pwr_ctrl_cfg mpu9250_vdd_pwr_ctrl_cfg = {
    .port = DT_LABEL(DT_INST(0, semtech_sx1509b)),
    .pin = MPU6050_VDD_PWR_CTRL_GPIO_PIN,
};

DEVICE_DEFINE(mpu9250_vdd_pwr_ctrl_initx, "", mpu_ctrl_init, NULL, NULL,
              &mpu9250_vdd_pwr_ctrl_cfg, POST_KERNEL,
              CONFIG_BOARD_CCS_VDD_PWR_CTRL_INIT_PRIORITY, NULL);

//!SX150B POWER MPU9250 DEVICE ON AT BOOT----------------------END
```

## src/mobile_rssi.c
```c
#include <kernel.h>
#include <stddef.h>

#include <stdbool.h>
#include <string.h>

#include <sys/printk.h>
#include <sys/util.h>

#include <bluetooth/bluetooth.h>
#include <bluetooth/hci.h>

#include "mobile_rssi.h"
#include "mobile_connect.h"

// Holds received advertisement data from each node
static struct NodeData nodeData[STATIC_NODE_NUM];
// Semaphores to signal that advertisement was received from node at that index
static struct k_sem scannedSems[STATIC_NODE_NUM];
// Semaphore to signal that a scan has been completed
static struct k_sem scanDoneSem;
/* Stores the target device mac address */
char* target_device_names[] = {
    "F5:75:FE:85:34:67",
    "E5:73:87:06:1E:86",
    "CA:99:9E:FD:98:B1",
    "CB:1B:89:82:FF:FE",
    "D4:D2:A0:A4:5C:AC",
    "C1:13:27:E9:B7:7C",
    "F1:04:48:06:39:A0",
    "CA:0C:E0:DB:CE:60",
    "D4:7F:D4:7C:20:13",
    "F7:0B:21:F1:C8:E1",
    "FD:E0:8D:FA:3E:4A",
    "EE:32:F7:28:FA:AC"
};

/**
 * @brief Initialise all semaphores used in BLE advertisement scanning
 */
static void scanned_sem_init(void) {
    k_sem_init(&scanDoneSem, 0, 1);
    for (int i = 0; i < STATIC_NODE_NUM; ++i) {
        k_sem_init(&scannedSems[i], 0, 1);
    }
}

/**
 * @brief Callback for when an advertisement has been found
 * 
 * @param addr : BLE address of the advertiser
 * @param rssi : Received signal strength indicator of the advertisement
 * @param advType : Type of advertisement
 * @param ad : The scanned advertisement
 */
static void scan_cb(const bt_addr_le_t *addr, int8_t rssi, uint8_t advType, struct net_buf_simple *ad) {
    // Get MAC address
    char addr_str[BT_ADDR_LE_STR_LEN];
	bt_addr_le_to_str(addr, addr_str, sizeof(addr_str));
    char* reduced_address = strtok(addr_str, " ");
    // printk("Device found: %s (RSSI %d)\n", reduced_address, rssi);
    for (int i = 0; i < STATIC_NODE_NUM; ++i) {
        // See if a valid node; if so, save data
        if (strcmp(reduced_address, target_device_names[i]) == 0) {
            nodeData[i].rssi = rssi;
            k_sem_give(&scannedSems[i]);
        }
    }
}

/**
 * @brief Thread to scan for BLE advertisements
 */
void thread_ble_scan(void)
{
    // Setup passive scan with 40ms interval 40ms window (constant scan)
    struct bt_le_scan_param scanParams = {
        .type = BT_HCI_LE_SCAN_PASSIVE,
        .options = BT_LE_SCAN_OPT_NONE,
        .interval = 0x0040,
        .window = 0x0040};
    int err;
    // Initialise all semaphores used in scanning routine
    scanned_sem_init();
    err = bt_le_scan_start(&scanParams, scan_cb);
    if (err) {
        printk("Starting scanning failed (err %d)\n", err);
        return;
    }
    while (1) {
        // Wait for the period time then signal scan complete
        k_msleep(MOBILE_BASE_SCAN_PERIOD);
        k_sem_give(&scanDoneSem);
    }
}

/**
 * @brief Thread to print static node ads to console
 * NOTE: THIS WILL BE DEPRECIATED
 */
void thread_ble_send(void) {
    int err;
    int total = 0, missed = 0;
    while (1) {
        k_sem_take(&scanDoneSem, K_FOREVER);
        // printk("Scan done\n");
        ++total;
        for (int i = 0; i < STATIC_NODE_NUM; ++i) {
            // Wait max 30ms before deciding that nodes ad was missed
            err = k_sem_take(&scannedSems[i], K_MSEC(30));
            if (err == -EAGAIN) {
                if (i == 0) {
                    ++missed;
                }
                // sem_take timed out, data was therefore missed
                // printk("Node %d ad was missed\n", i + 1);
                node_rssi[i] = 0;
            }
            else {
                //Update GATT Characteristic Buffers
                node_rssi[i] = nodeData[i].rssi;
                // printk("rssi: %d\n", node_rssi[i]);
            }
        }
    }
}
```
